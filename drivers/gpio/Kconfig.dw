## drivers/gpio/Kconfig.dw
```kconfig
# DesignWare GPIO configuration options

# Copyright (c) 2016 Intel Corporation
# SPDX-License-Identifier: Apache-2.0

config GPIO_DW
	bool "Designware GPIO"
	default y
	depends on DT_HAS_SNPS_DESIGNWARE_GPIO_ENABLED
	help
	  Enable driver for Designware GPIO

if GPIO_DW

config GPIO_DW_MMIO_PARENT
	bool "Use map register area from parent node"
	default n
	help
	  Use map register area from parent node.

endif #GPIO_DW
```
